## swupdate/swupdate.its
```
/dts-v1/;
  
/ {
	description = "U-Boot fitImage for NTC CHIP";
	#address-cells = <1>;
  
	images {
		kernel {
			description = "Linux Kernel";
			data = /incbin/("./zImage");
			type = "kernel";
			arch = "arm";
			os = "linux";
			compression = "none";
			load = <0x42000000>;
			entry = <0x42000000>;
			hash {
				algo = "sha1";
			};
		};
		fdt {
			description = "Flattened Device Tree blob";
			data = /incbin/("./sun5i-r8-chip.dtb");
			type = "flat_dt";
			arch = "arm";
			compression = "none";
			hash {
				algo = "sha1";
			};
		};
		ramdisk {
			description = "ramdisk";
			data = /incbin/("./rootfs.cpio.xz");
			type = "ramdisk";
			arch = "arm64";
			os = "linux";
			compression = "none";
			hash {
				algo = "sha1";
			};
		};
	};
	configurations {
		default = "conf";
		conf {
			description = "Boot Linux kernel with FDT blob + ramdisk";
			kernel = "kernel";
			fdt = "fdt";
			ramdisk = "ramdisk";
			hash {
				algo = "sha1";
			};
		};
	};
};
```
